#include "Deskiny.dtsi"


&default_transform {
	col-offset = <6>;
};

&default_kscan {
        col-gpios 
        = <&xiao_d 7 (GPIO_ACTIVE_HIGH)>
        , <&xiao_d 8 (GPIO_ACTIVE_HIGH)>
        , <&xiao_d 9 (GPIO_ACTIVE_HIGH)>
        , <&xiao_d 6 (GPIO_ACTIVE_HIGH)>
        , <&xiao_d 5 (GPIO_ACTIVE_HIGH)>  
        , <&xiao_d 4 (GPIO_ACTIVE_HIGH)> 
        ;
 };