## zmk-config-Deskiny/config/boards/shields/Deskiny/Kconfig.defconfig
```kconfig
if SHIELD_DESKINY_LEFT

config ZMK_KEYBOARD_NAME
    default "DESKINY"

config ZMK_SPLIT_ROLE_CENTRAL
    default y

endif #LEFT

if SHIELD_DESKINY_LEFT || SHIELD_DESKINY_RIGHT

    config ZMK_SPLIT
        default y

endif
```

## zmk-config-Deskiny/config/boards/shields/Deskiny/Kconfig.shield
```kconfig
config SHIELD_DESKINY_LEFT
    def_bool $(shields_list_contains,Deskiny_left)
    
config SHIELD_DESKINY_RIGHT
    def_bool $(shields_list_contains,Deskiny_right)
```
